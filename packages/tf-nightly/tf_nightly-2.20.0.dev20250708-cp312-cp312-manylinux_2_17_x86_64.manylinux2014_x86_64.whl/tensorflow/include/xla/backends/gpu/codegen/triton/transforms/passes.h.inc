/* Autogenerated by mlir-tblgen; don't manually edit */

#ifdef GEN_PASS_DECL
// Generate declarations for all passes.
#define GEN_PASS_DECL_EXTRACTTMAINFOPASS
#define GEN_PASS_DECL_GENERALIZEKERNELSIGNATUREPASS
#define GEN_PASS_DECL_LOADINT4REWRITEPASS
#define GEN_PASS_DECL_PREVENTMMAV3LOOPUNROLLINGPASS
#define GEN_PASS_DECL_ROUNDF32TOTF32FORTF32DOTREWRITEPASS
#define GEN_PASS_DECL_TRITONXLAEXTRACTINSERTTOTRITONPASS
#undef GEN_PASS_DECL
#endif // GEN_PASS_DECL

//===----------------------------------------------------------------------===//
// ExtractTmaInfoPass
//===----------------------------------------------------------------------===//
#ifdef GEN_PASS_DECL_EXTRACTTMAINFOPASS
#undef GEN_PASS_DECL_EXTRACTTMAINFOPASS
#endif // GEN_PASS_DECL_EXTRACTTMAINFOPASS
#ifdef GEN_PASS_DEF_EXTRACTTMAINFOPASS
namespace impl {

template <typename DerivedT>
class ExtractTmaInfoPassBase : public ::mlir::OperationPass<mlir::ModuleOp> {
public:
  using Base = ExtractTmaInfoPassBase;

  ExtractTmaInfoPassBase() : ::mlir::OperationPass<mlir::ModuleOp>(::mlir::TypeID::get<DerivedT>()) {}
  ExtractTmaInfoPassBase(const ExtractTmaInfoPassBase &other) : ::mlir::OperationPass<mlir::ModuleOp>(other) {}
  ExtractTmaInfoPassBase& operator=(const ExtractTmaInfoPassBase &) = delete;
  ExtractTmaInfoPassBase(ExtractTmaInfoPassBase &&) = delete;
  ExtractTmaInfoPassBase& operator=(ExtractTmaInfoPassBase &&) = delete;
  ~ExtractTmaInfoPassBase() = default;

  /// Returns the command-line argument attached to this pass.
  static constexpr ::llvm::StringLiteral getArgumentName() {
    return ::llvm::StringLiteral("extract-tma-info");
  }
  ::llvm::StringRef getArgument() const override { return "extract-tma-info"; }

  ::llvm::StringRef getDescription() const override { return "Extract TMA info during Triton lowering."; }

  /// Returns the derived pass name.
  static constexpr ::llvm::StringLiteral getPassName() {
    return ::llvm::StringLiteral("ExtractTmaInfoPass");
  }
  ::llvm::StringRef getName() const override { return "ExtractTmaInfoPass"; }

  /// Support isa/dyn_cast functionality for the derived pass class.
  static bool classof(const ::mlir::Pass *pass) {
    return pass->getTypeID() == ::mlir::TypeID::get<DerivedT>();
  }

  /// A clone method to create a copy of this pass.
  std::unique_ptr<::mlir::Pass> clonePass() const override {
    return std::make_unique<DerivedT>(*static_cast<const DerivedT *>(this));
  }

  /// Return the dialect that must be loaded in the context before this pass.
  void getDependentDialects(::mlir::DialectRegistry &registry) const override {
    
  }

  /// Explicitly declare the TypeID for this class. We declare an explicit private
  /// instantiation because Pass classes should only be visible by the current
  /// library.
  MLIR_DEFINE_EXPLICIT_INTERNAL_INLINE_TYPE_ID(ExtractTmaInfoPassBase<DerivedT>)

protected:
private:
};
} // namespace impl
#undef GEN_PASS_DEF_EXTRACTTMAINFOPASS
#endif // GEN_PASS_DEF_EXTRACTTMAINFOPASS

//===----------------------------------------------------------------------===//
// GeneralizeKernelSignaturePass
//===----------------------------------------------------------------------===//
#ifdef GEN_PASS_DECL_GENERALIZEKERNELSIGNATUREPASS
#undef GEN_PASS_DECL_GENERALIZEKERNELSIGNATUREPASS
#endif // GEN_PASS_DECL_GENERALIZEKERNELSIGNATUREPASS
#ifdef GEN_PASS_DEF_GENERALIZEKERNELSIGNATUREPASS
namespace impl {

template <typename DerivedT>
class GeneralizeKernelSignaturePassBase : public ::mlir::OperationPass<> {
public:
  using Base = GeneralizeKernelSignaturePassBase;

  GeneralizeKernelSignaturePassBase() : ::mlir::OperationPass<>(::mlir::TypeID::get<DerivedT>()) {}
  GeneralizeKernelSignaturePassBase(const GeneralizeKernelSignaturePassBase &other) : ::mlir::OperationPass<>(other) {}
  GeneralizeKernelSignaturePassBase& operator=(const GeneralizeKernelSignaturePassBase &) = delete;
  GeneralizeKernelSignaturePassBase(GeneralizeKernelSignaturePassBase &&) = delete;
  GeneralizeKernelSignaturePassBase& operator=(GeneralizeKernelSignaturePassBase &&) = delete;
  ~GeneralizeKernelSignaturePassBase() = default;

  /// Returns the command-line argument attached to this pass.
  static constexpr ::llvm::StringLiteral getArgumentName() {
    return ::llvm::StringLiteral("generalize-kernel-signature");
  }
  ::llvm::StringRef getArgument() const override { return "generalize-kernel-signature"; }

  ::llvm::StringRef getDescription() const override { return "Rewrite kernels to use generic data pointer arguments."; }

  /// Returns the derived pass name.
  static constexpr ::llvm::StringLiteral getPassName() {
    return ::llvm::StringLiteral("GeneralizeKernelSignaturePass");
  }
  ::llvm::StringRef getName() const override { return "GeneralizeKernelSignaturePass"; }

  /// Support isa/dyn_cast functionality for the derived pass class.
  static bool classof(const ::mlir::Pass *pass) {
    return pass->getTypeID() == ::mlir::TypeID::get<DerivedT>();
  }

  /// A clone method to create a copy of this pass.
  std::unique_ptr<::mlir::Pass> clonePass() const override {
    return std::make_unique<DerivedT>(*static_cast<const DerivedT *>(this));
  }

  /// Return the dialect that must be loaded in the context before this pass.
  void getDependentDialects(::mlir::DialectRegistry &registry) const override {
    
  }

  /// Explicitly declare the TypeID for this class. We declare an explicit private
  /// instantiation because Pass classes should only be visible by the current
  /// library.
  MLIR_DEFINE_EXPLICIT_INTERNAL_INLINE_TYPE_ID(GeneralizeKernelSignaturePassBase<DerivedT>)

protected:
private:
};
} // namespace impl
#undef GEN_PASS_DEF_GENERALIZEKERNELSIGNATUREPASS
#endif // GEN_PASS_DEF_GENERALIZEKERNELSIGNATUREPASS

//===----------------------------------------------------------------------===//
// LoadInt4RewritePass
//===----------------------------------------------------------------------===//
#ifdef GEN_PASS_DECL_LOADINT4REWRITEPASS
#undef GEN_PASS_DECL_LOADINT4REWRITEPASS
#endif // GEN_PASS_DECL_LOADINT4REWRITEPASS
#ifdef GEN_PASS_DEF_LOADINT4REWRITEPASS
namespace impl {

template <typename DerivedT>
class LoadInt4RewritePassBase : public ::mlir::OperationPass<mlir::ModuleOp> {
public:
  using Base = LoadInt4RewritePassBase;

  LoadInt4RewritePassBase() : ::mlir::OperationPass<mlir::ModuleOp>(::mlir::TypeID::get<DerivedT>()) {}
  LoadInt4RewritePassBase(const LoadInt4RewritePassBase &other) : ::mlir::OperationPass<mlir::ModuleOp>(other) {}
  LoadInt4RewritePassBase& operator=(const LoadInt4RewritePassBase &) = delete;
  LoadInt4RewritePassBase(LoadInt4RewritePassBase &&) = delete;
  LoadInt4RewritePassBase& operator=(LoadInt4RewritePassBase &&) = delete;
  ~LoadInt4RewritePassBase() = default;

  /// Returns the command-line argument attached to this pass.
  static constexpr ::llvm::StringLiteral getArgumentName() {
    return ::llvm::StringLiteral("int4-to-packed-int4-rewrite");
  }
  ::llvm::StringRef getArgument() const override { return "int4-to-packed-int4-rewrite"; }

  ::llvm::StringRef getDescription() const override { return "Converts ops with int4 tensors to the ops with int4 packed to int8 tensors."; }

  /// Returns the derived pass name.
  static constexpr ::llvm::StringLiteral getPassName() {
    return ::llvm::StringLiteral("LoadInt4RewritePass");
  }
  ::llvm::StringRef getName() const override { return "LoadInt4RewritePass"; }

  /// Support isa/dyn_cast functionality for the derived pass class.
  static bool classof(const ::mlir::Pass *pass) {
    return pass->getTypeID() == ::mlir::TypeID::get<DerivedT>();
  }

  /// A clone method to create a copy of this pass.
  std::unique_ptr<::mlir::Pass> clonePass() const override {
    return std::make_unique<DerivedT>(*static_cast<const DerivedT *>(this));
  }

  /// Return the dialect that must be loaded in the context before this pass.
  void getDependentDialects(::mlir::DialectRegistry &registry) const override {
    registry.insert<triton::TritonDialect>();
  }

  /// Explicitly declare the TypeID for this class. We declare an explicit private
  /// instantiation because Pass classes should only be visible by the current
  /// library.
  MLIR_DEFINE_EXPLICIT_INTERNAL_INLINE_TYPE_ID(LoadInt4RewritePassBase<DerivedT>)

protected:
private:
};
} // namespace impl
#undef GEN_PASS_DEF_LOADINT4REWRITEPASS
#endif // GEN_PASS_DEF_LOADINT4REWRITEPASS

//===----------------------------------------------------------------------===//
// PreventMmaV3LoopUnrollingPass
//===----------------------------------------------------------------------===//
#ifdef GEN_PASS_DECL_PREVENTMMAV3LOOPUNROLLINGPASS
#undef GEN_PASS_DECL_PREVENTMMAV3LOOPUNROLLINGPASS
#endif // GEN_PASS_DECL_PREVENTMMAV3LOOPUNROLLINGPASS
#ifdef GEN_PASS_DEF_PREVENTMMAV3LOOPUNROLLINGPASS
namespace impl {

template <typename DerivedT>
class PreventMmaV3LoopUnrollingPassBase : public ::mlir::OperationPass<mlir::ModuleOp> {
public:
  using Base = PreventMmaV3LoopUnrollingPassBase;

  PreventMmaV3LoopUnrollingPassBase() : ::mlir::OperationPass<mlir::ModuleOp>(::mlir::TypeID::get<DerivedT>()) {}
  PreventMmaV3LoopUnrollingPassBase(const PreventMmaV3LoopUnrollingPassBase &other) : ::mlir::OperationPass<mlir::ModuleOp>(other) {}
  PreventMmaV3LoopUnrollingPassBase& operator=(const PreventMmaV3LoopUnrollingPassBase &) = delete;
  PreventMmaV3LoopUnrollingPassBase(PreventMmaV3LoopUnrollingPassBase &&) = delete;
  PreventMmaV3LoopUnrollingPassBase& operator=(PreventMmaV3LoopUnrollingPassBase &&) = delete;
  ~PreventMmaV3LoopUnrollingPassBase() = default;

  /// Returns the command-line argument attached to this pass.
  static constexpr ::llvm::StringLiteral getArgumentName() {
    return ::llvm::StringLiteral("prevent-mmav3-loop-unrolling");
  }
  ::llvm::StringRef getArgument() const override { return "prevent-mmav3-loop-unrolling"; }

  ::llvm::StringRef getDescription() const override { return "Prevent MMAv3 loop unrolling."; }

  /// Returns the derived pass name.
  static constexpr ::llvm::StringLiteral getPassName() {
    return ::llvm::StringLiteral("PreventMmaV3LoopUnrollingPass");
  }
  ::llvm::StringRef getName() const override { return "PreventMmaV3LoopUnrollingPass"; }

  /// Support isa/dyn_cast functionality for the derived pass class.
  static bool classof(const ::mlir::Pass *pass) {
    return pass->getTypeID() == ::mlir::TypeID::get<DerivedT>();
  }

  /// A clone method to create a copy of this pass.
  std::unique_ptr<::mlir::Pass> clonePass() const override {
    return std::make_unique<DerivedT>(*static_cast<const DerivedT *>(this));
  }

  /// Return the dialect that must be loaded in the context before this pass.
  void getDependentDialects(::mlir::DialectRegistry &registry) const override {
    
  }

  /// Explicitly declare the TypeID for this class. We declare an explicit private
  /// instantiation because Pass classes should only be visible by the current
  /// library.
  MLIR_DEFINE_EXPLICIT_INTERNAL_INLINE_TYPE_ID(PreventMmaV3LoopUnrollingPassBase<DerivedT>)

protected:
private:
};
} // namespace impl
#undef GEN_PASS_DEF_PREVENTMMAV3LOOPUNROLLINGPASS
#endif // GEN_PASS_DEF_PREVENTMMAV3LOOPUNROLLINGPASS

//===----------------------------------------------------------------------===//
// RoundF32ToTF32ForTf32DotRewritePass
//===----------------------------------------------------------------------===//
#ifdef GEN_PASS_DECL_ROUNDF32TOTF32FORTF32DOTREWRITEPASS
#undef GEN_PASS_DECL_ROUNDF32TOTF32FORTF32DOTREWRITEPASS
#endif // GEN_PASS_DECL_ROUNDF32TOTF32FORTF32DOTREWRITEPASS
#ifdef GEN_PASS_DEF_ROUNDF32TOTF32FORTF32DOTREWRITEPASS
namespace impl {

template <typename DerivedT>
class RoundF32ToTF32ForTf32DotRewritePassBase : public ::mlir::OperationPass<mlir::ModuleOp> {
public:
  using Base = RoundF32ToTF32ForTf32DotRewritePassBase;

  RoundF32ToTF32ForTf32DotRewritePassBase() : ::mlir::OperationPass<mlir::ModuleOp>(::mlir::TypeID::get<DerivedT>()) {}
  RoundF32ToTF32ForTf32DotRewritePassBase(const RoundF32ToTF32ForTf32DotRewritePassBase &other) : ::mlir::OperationPass<mlir::ModuleOp>(other) {}
  RoundF32ToTF32ForTf32DotRewritePassBase& operator=(const RoundF32ToTF32ForTf32DotRewritePassBase &) = delete;
  RoundF32ToTF32ForTf32DotRewritePassBase(RoundF32ToTF32ForTf32DotRewritePassBase &&) = delete;
  RoundF32ToTF32ForTf32DotRewritePassBase& operator=(RoundF32ToTF32ForTf32DotRewritePassBase &&) = delete;
  ~RoundF32ToTF32ForTf32DotRewritePassBase() = default;

  /// Returns the command-line argument attached to this pass.
  static constexpr ::llvm::StringLiteral getArgumentName() {
    return ::llvm::StringLiteral("round-f32-to-tf32-for-tf32-dot-rewrite");
  }
  ::llvm::StringRef getArgument() const override { return "round-f32-to-tf32-for-tf32-dot-rewrite"; }

  ::llvm::StringRef getDescription() const override { return "dot with tf32 algorithm requires explicit rounding."; }

  /// Returns the derived pass name.
  static constexpr ::llvm::StringLiteral getPassName() {
    return ::llvm::StringLiteral("RoundF32ToTF32ForTf32DotRewritePass");
  }
  ::llvm::StringRef getName() const override { return "RoundF32ToTF32ForTf32DotRewritePass"; }

  /// Support isa/dyn_cast functionality for the derived pass class.
  static bool classof(const ::mlir::Pass *pass) {
    return pass->getTypeID() == ::mlir::TypeID::get<DerivedT>();
  }

  /// A clone method to create a copy of this pass.
  std::unique_ptr<::mlir::Pass> clonePass() const override {
    return std::make_unique<DerivedT>(*static_cast<const DerivedT *>(this));
  }

  /// Return the dialect that must be loaded in the context before this pass.
  void getDependentDialects(::mlir::DialectRegistry &registry) const override {
    
  }

  /// Explicitly declare the TypeID for this class. We declare an explicit private
  /// instantiation because Pass classes should only be visible by the current
  /// library.
  MLIR_DEFINE_EXPLICIT_INTERNAL_INLINE_TYPE_ID(RoundF32ToTF32ForTf32DotRewritePassBase<DerivedT>)

protected:
private:
};
} // namespace impl
#undef GEN_PASS_DEF_ROUNDF32TOTF32FORTF32DOTREWRITEPASS
#endif // GEN_PASS_DEF_ROUNDF32TOTF32FORTF32DOTREWRITEPASS

//===----------------------------------------------------------------------===//
// TritonXLAExtractInsertToTritonPass
//===----------------------------------------------------------------------===//
#ifdef GEN_PASS_DECL_TRITONXLAEXTRACTINSERTTOTRITONPASS
#undef GEN_PASS_DECL_TRITONXLAEXTRACTINSERTTOTRITONPASS
#endif // GEN_PASS_DECL_TRITONXLAEXTRACTINSERTTOTRITONPASS
#ifdef GEN_PASS_DEF_TRITONXLAEXTRACTINSERTTOTRITONPASS
namespace impl {

template <typename DerivedT>
class TritonXLAExtractInsertToTritonPassBase : public ::mlir::OperationPass<mlir::ModuleOp> {
public:
  using Base = TritonXLAExtractInsertToTritonPassBase;

  TritonXLAExtractInsertToTritonPassBase() : ::mlir::OperationPass<mlir::ModuleOp>(::mlir::TypeID::get<DerivedT>()) {}
  TritonXLAExtractInsertToTritonPassBase(const TritonXLAExtractInsertToTritonPassBase &other) : ::mlir::OperationPass<mlir::ModuleOp>(other) {}
  TritonXLAExtractInsertToTritonPassBase& operator=(const TritonXLAExtractInsertToTritonPassBase &) = delete;
  TritonXLAExtractInsertToTritonPassBase(TritonXLAExtractInsertToTritonPassBase &&) = delete;
  TritonXLAExtractInsertToTritonPassBase& operator=(TritonXLAExtractInsertToTritonPassBase &&) = delete;
  ~TritonXLAExtractInsertToTritonPassBase() = default;

  /// Returns the command-line argument attached to this pass.
  static constexpr ::llvm::StringLiteral getArgumentName() {
    return ::llvm::StringLiteral("triton-xla-extract-insert-to-triton");
  }
  ::llvm::StringRef getArgument() const override { return "triton-xla-extract-insert-to-triton"; }

  ::llvm::StringRef getDescription() const override { return "Convert Triton XLA extract and insert ops to Triton ops."; }

  /// Returns the derived pass name.
  static constexpr ::llvm::StringLiteral getPassName() {
    return ::llvm::StringLiteral("TritonXLAExtractInsertToTritonPass");
  }
  ::llvm::StringRef getName() const override { return "TritonXLAExtractInsertToTritonPass"; }

  /// Support isa/dyn_cast functionality for the derived pass class.
  static bool classof(const ::mlir::Pass *pass) {
    return pass->getTypeID() == ::mlir::TypeID::get<DerivedT>();
  }

  /// A clone method to create a copy of this pass.
  std::unique_ptr<::mlir::Pass> clonePass() const override {
    return std::make_unique<DerivedT>(*static_cast<const DerivedT *>(this));
  }

  /// Return the dialect that must be loaded in the context before this pass.
  void getDependentDialects(::mlir::DialectRegistry &registry) const override {
    registry.insert<triton::TritonDialect>();
    registry.insert<::xla::XlaDialect>();
  }

  /// Explicitly declare the TypeID for this class. We declare an explicit private
  /// instantiation because Pass classes should only be visible by the current
  /// library.
  MLIR_DEFINE_EXPLICIT_INTERNAL_INLINE_TYPE_ID(TritonXLAExtractInsertToTritonPassBase<DerivedT>)

protected:
private:
};
} // namespace impl
#undef GEN_PASS_DEF_TRITONXLAEXTRACTINSERTTOTRITONPASS
#endif // GEN_PASS_DEF_TRITONXLAEXTRACTINSERTTOTRITONPASS
#ifdef GEN_PASS_REGISTRATION

//===----------------------------------------------------------------------===//
// ExtractTmaInfoPass Registration
//===----------------------------------------------------------------------===//

inline void registerExtractTmaInfoPass() {
  ::mlir::registerPass([]() -> std::unique_ptr<::mlir::Pass> {
    return CreateExtractTmaInfoPass();
  });
}

// Old registration code, kept for temporary backwards compatibility.
inline void registerExtractTmaInfoPassPass() {
  ::mlir::registerPass([]() -> std::unique_ptr<::mlir::Pass> {
    return CreateExtractTmaInfoPass();
  });
}

//===----------------------------------------------------------------------===//
// GeneralizeKernelSignaturePass Registration
//===----------------------------------------------------------------------===//

inline void registerGeneralizeKernelSignaturePass() {
  ::mlir::registerPass([]() -> std::unique_ptr<::mlir::Pass> {
    return CreateGeneralizeKernelSignaturePass();
  });
}

// Old registration code, kept for temporary backwards compatibility.
inline void registerGeneralizeKernelSignaturePassPass() {
  ::mlir::registerPass([]() -> std::unique_ptr<::mlir::Pass> {
    return CreateGeneralizeKernelSignaturePass();
  });
}

//===----------------------------------------------------------------------===//
// LoadInt4RewritePass Registration
//===----------------------------------------------------------------------===//

inline void registerLoadInt4RewritePass() {
  ::mlir::registerPass([]() -> std::unique_ptr<::mlir::Pass> {
    return CreateInt4ToPackedInt4RewritePass();
  });
}

// Old registration code, kept for temporary backwards compatibility.
inline void registerLoadInt4RewritePassPass() {
  ::mlir::registerPass([]() -> std::unique_ptr<::mlir::Pass> {
    return CreateInt4ToPackedInt4RewritePass();
  });
}

//===----------------------------------------------------------------------===//
// PreventMmaV3LoopUnrollingPass Registration
//===----------------------------------------------------------------------===//

inline void registerPreventMmaV3LoopUnrollingPass() {
  ::mlir::registerPass([]() -> std::unique_ptr<::mlir::Pass> {
    return CreatePreventMmaV3LoopUnrollingPass();
  });
}

// Old registration code, kept for temporary backwards compatibility.
inline void registerPreventMmaV3LoopUnrollingPassPass() {
  ::mlir::registerPass([]() -> std::unique_ptr<::mlir::Pass> {
    return CreatePreventMmaV3LoopUnrollingPass();
  });
}

//===----------------------------------------------------------------------===//
// RoundF32ToTF32ForTf32DotRewritePass Registration
//===----------------------------------------------------------------------===//

inline void registerRoundF32ToTF32ForTf32DotRewritePass() {
  ::mlir::registerPass([]() -> std::unique_ptr<::mlir::Pass> {
    return CreateRoundF32ToTF32ForTf32DotRewritePass();
  });
}

// Old registration code, kept for temporary backwards compatibility.
inline void registerRoundF32ToTF32ForTf32DotRewritePassPass() {
  ::mlir::registerPass([]() -> std::unique_ptr<::mlir::Pass> {
    return CreateRoundF32ToTF32ForTf32DotRewritePass();
  });
}

//===----------------------------------------------------------------------===//
// TritonXLAExtractInsertToTritonPass Registration
//===----------------------------------------------------------------------===//

inline void registerTritonXLAExtractInsertToTritonPass() {
  ::mlir::registerPass([]() -> std::unique_ptr<::mlir::Pass> {
    return CreateTritonXLAExtractInsertToTritonPass();
  });
}

// Old registration code, kept for temporary backwards compatibility.
inline void registerTritonXLAExtractInsertToTritonPassPass() {
  ::mlir::registerPass([]() -> std::unique_ptr<::mlir::Pass> {
    return CreateTritonXLAExtractInsertToTritonPass();
  });
}

//===----------------------------------------------------------------------===//
// TritonXlaTransforms Registration
//===----------------------------------------------------------------------===//

inline void registerTritonXlaTransformsPasses() {
  registerExtractTmaInfoPass();
  registerGeneralizeKernelSignaturePass();
  registerLoadInt4RewritePass();
  registerPreventMmaV3LoopUnrollingPass();
  registerRoundF32ToTF32ForTf32DotRewritePass();
  registerTritonXLAExtractInsertToTritonPass();
}
#undef GEN_PASS_REGISTRATION
#endif // GEN_PASS_REGISTRATION
// Deprecated. Please use the new per-pass macros.
#ifdef GEN_PASS_CLASSES

template <typename DerivedT>
class ExtractTmaInfoPassBase : public ::mlir::OperationPass<mlir::ModuleOp> {
public:
  using Base = ExtractTmaInfoPassBase;

  ExtractTmaInfoPassBase() : ::mlir::OperationPass<mlir::ModuleOp>(::mlir::TypeID::get<DerivedT>()) {}
  ExtractTmaInfoPassBase(const ExtractTmaInfoPassBase &other) : ::mlir::OperationPass<mlir::ModuleOp>(other) {}
  ExtractTmaInfoPassBase& operator=(const ExtractTmaInfoPassBase &) = delete;
  ExtractTmaInfoPassBase(ExtractTmaInfoPassBase &&) = delete;
  ExtractTmaInfoPassBase& operator=(ExtractTmaInfoPassBase &&) = delete;
  ~ExtractTmaInfoPassBase() = default;

  /// Returns the command-line argument attached to this pass.
  static constexpr ::llvm::StringLiteral getArgumentName() {
    return ::llvm::StringLiteral("extract-tma-info");
  }
  ::llvm::StringRef getArgument() const override { return "extract-tma-info"; }

  ::llvm::StringRef getDescription() const override { return "Extract TMA info during Triton lowering."; }

  /// Returns the derived pass name.
  static constexpr ::llvm::StringLiteral getPassName() {
    return ::llvm::StringLiteral("ExtractTmaInfoPass");
  }
  ::llvm::StringRef getName() const override { return "ExtractTmaInfoPass"; }

  /// Support isa/dyn_cast functionality for the derived pass class.
  static bool classof(const ::mlir::Pass *pass) {
    return pass->getTypeID() == ::mlir::TypeID::get<DerivedT>();
  }

  /// A clone method to create a copy of this pass.
  std::unique_ptr<::mlir::Pass> clonePass() const override {
    return std::make_unique<DerivedT>(*static_cast<const DerivedT *>(this));
  }

  /// Register the dialects that must be loaded in the context before this pass.
  void getDependentDialects(::mlir::DialectRegistry &registry) const override {
    
  }

  /// Explicitly declare the TypeID for this class. We declare an explicit private
  /// instantiation because Pass classes should only be visible by the current
  /// library.
  MLIR_DEFINE_EXPLICIT_INTERNAL_INLINE_TYPE_ID(ExtractTmaInfoPassBase<DerivedT>)

protected:
};

template <typename DerivedT>
class GeneralizeKernelSignaturePassBase : public ::mlir::OperationPass<> {
public:
  using Base = GeneralizeKernelSignaturePassBase;

  GeneralizeKernelSignaturePassBase() : ::mlir::OperationPass<>(::mlir::TypeID::get<DerivedT>()) {}
  GeneralizeKernelSignaturePassBase(const GeneralizeKernelSignaturePassBase &other) : ::mlir::OperationPass<>(other) {}
  GeneralizeKernelSignaturePassBase& operator=(const GeneralizeKernelSignaturePassBase &) = delete;
  GeneralizeKernelSignaturePassBase(GeneralizeKernelSignaturePassBase &&) = delete;
  GeneralizeKernelSignaturePassBase& operator=(GeneralizeKernelSignaturePassBase &&) = delete;
  ~GeneralizeKernelSignaturePassBase() = default;

  /// Returns the command-line argument attached to this pass.
  static constexpr ::llvm::StringLiteral getArgumentName() {
    return ::llvm::StringLiteral("generalize-kernel-signature");
  }
  ::llvm::StringRef getArgument() const override { return "generalize-kernel-signature"; }

  ::llvm::StringRef getDescription() const override { return "Rewrite kernels to use generic data pointer arguments."; }

  /// Returns the derived pass name.
  static constexpr ::llvm::StringLiteral getPassName() {
    return ::llvm::StringLiteral("GeneralizeKernelSignaturePass");
  }
  ::llvm::StringRef getName() const override { return "GeneralizeKernelSignaturePass"; }

  /// Support isa/dyn_cast functionality for the derived pass class.
  static bool classof(const ::mlir::Pass *pass) {
    return pass->getTypeID() == ::mlir::TypeID::get<DerivedT>();
  }

  /// A clone method to create a copy of this pass.
  std::unique_ptr<::mlir::Pass> clonePass() const override {
    return std::make_unique<DerivedT>(*static_cast<const DerivedT *>(this));
  }

  /// Register the dialects that must be loaded in the context before this pass.
  void getDependentDialects(::mlir::DialectRegistry &registry) const override {
    
  }

  /// Explicitly declare the TypeID for this class. We declare an explicit private
  /// instantiation because Pass classes should only be visible by the current
  /// library.
  MLIR_DEFINE_EXPLICIT_INTERNAL_INLINE_TYPE_ID(GeneralizeKernelSignaturePassBase<DerivedT>)

protected:
};

template <typename DerivedT>
class LoadInt4RewritePassBase : public ::mlir::OperationPass<mlir::ModuleOp> {
public:
  using Base = LoadInt4RewritePassBase;

  LoadInt4RewritePassBase() : ::mlir::OperationPass<mlir::ModuleOp>(::mlir::TypeID::get<DerivedT>()) {}
  LoadInt4RewritePassBase(const LoadInt4RewritePassBase &other) : ::mlir::OperationPass<mlir::ModuleOp>(other) {}
  LoadInt4RewritePassBase& operator=(const LoadInt4RewritePassBase &) = delete;
  LoadInt4RewritePassBase(LoadInt4RewritePassBase &&) = delete;
  LoadInt4RewritePassBase& operator=(LoadInt4RewritePassBase &&) = delete;
  ~LoadInt4RewritePassBase() = default;

  /// Returns the command-line argument attached to this pass.
  static constexpr ::llvm::StringLiteral getArgumentName() {
    return ::llvm::StringLiteral("int4-to-packed-int4-rewrite");
  }
  ::llvm::StringRef getArgument() const override { return "int4-to-packed-int4-rewrite"; }

  ::llvm::StringRef getDescription() const override { return "Converts ops with int4 tensors to the ops with int4 packed to int8 tensors."; }

  /// Returns the derived pass name.
  static constexpr ::llvm::StringLiteral getPassName() {
    return ::llvm::StringLiteral("LoadInt4RewritePass");
  }
  ::llvm::StringRef getName() const override { return "LoadInt4RewritePass"; }

  /// Support isa/dyn_cast functionality for the derived pass class.
  static bool classof(const ::mlir::Pass *pass) {
    return pass->getTypeID() == ::mlir::TypeID::get<DerivedT>();
  }

  /// A clone method to create a copy of this pass.
  std::unique_ptr<::mlir::Pass> clonePass() const override {
    return std::make_unique<DerivedT>(*static_cast<const DerivedT *>(this));
  }

  /// Register the dialects that must be loaded in the context before this pass.
  void getDependentDialects(::mlir::DialectRegistry &registry) const override {
    registry.insert<triton::TritonDialect>();
  }

  /// Explicitly declare the TypeID for this class. We declare an explicit private
  /// instantiation because Pass classes should only be visible by the current
  /// library.
  MLIR_DEFINE_EXPLICIT_INTERNAL_INLINE_TYPE_ID(LoadInt4RewritePassBase<DerivedT>)

protected:
};

template <typename DerivedT>
class PreventMmaV3LoopUnrollingPassBase : public ::mlir::OperationPass<mlir::ModuleOp> {
public:
  using Base = PreventMmaV3LoopUnrollingPassBase;

  PreventMmaV3LoopUnrollingPassBase() : ::mlir::OperationPass<mlir::ModuleOp>(::mlir::TypeID::get<DerivedT>()) {}
  PreventMmaV3LoopUnrollingPassBase(const PreventMmaV3LoopUnrollingPassBase &other) : ::mlir::OperationPass<mlir::ModuleOp>(other) {}
  PreventMmaV3LoopUnrollingPassBase& operator=(const PreventMmaV3LoopUnrollingPassBase &) = delete;
  PreventMmaV3LoopUnrollingPassBase(PreventMmaV3LoopUnrollingPassBase &&) = delete;
  PreventMmaV3LoopUnrollingPassBase& operator=(PreventMmaV3LoopUnrollingPassBase &&) = delete;
  ~PreventMmaV3LoopUnrollingPassBase() = default;

  /// Returns the command-line argument attached to this pass.
  static constexpr ::llvm::StringLiteral getArgumentName() {
    return ::llvm::StringLiteral("prevent-mmav3-loop-unrolling");
  }
  ::llvm::StringRef getArgument() const override { return "prevent-mmav3-loop-unrolling"; }

  ::llvm::StringRef getDescription() const override { return "Prevent MMAv3 loop unrolling."; }

  /// Returns the derived pass name.
  static constexpr ::llvm::StringLiteral getPassName() {
    return ::llvm::StringLiteral("PreventMmaV3LoopUnrollingPass");
  }
  ::llvm::StringRef getName() const override { return "PreventMmaV3LoopUnrollingPass"; }

  /// Support isa/dyn_cast functionality for the derived pass class.
  static bool classof(const ::mlir::Pass *pass) {
    return pass->getTypeID() == ::mlir::TypeID::get<DerivedT>();
  }

  /// A clone method to create a copy of this pass.
  std::unique_ptr<::mlir::Pass> clonePass() const override {
    return std::make_unique<DerivedT>(*static_cast<const DerivedT *>(this));
  }

  /// Register the dialects that must be loaded in the context before this pass.
  void getDependentDialects(::mlir::DialectRegistry &registry) const override {
    
  }

  /// Explicitly declare the TypeID for this class. We declare an explicit private
  /// instantiation because Pass classes should only be visible by the current
  /// library.
  MLIR_DEFINE_EXPLICIT_INTERNAL_INLINE_TYPE_ID(PreventMmaV3LoopUnrollingPassBase<DerivedT>)

protected:
};

template <typename DerivedT>
class RoundF32ToTF32ForTf32DotRewritePassBase : public ::mlir::OperationPass<mlir::ModuleOp> {
public:
  using Base = RoundF32ToTF32ForTf32DotRewritePassBase;

  RoundF32ToTF32ForTf32DotRewritePassBase() : ::mlir::OperationPass<mlir::ModuleOp>(::mlir::TypeID::get<DerivedT>()) {}
  RoundF32ToTF32ForTf32DotRewritePassBase(const RoundF32ToTF32ForTf32DotRewritePassBase &other) : ::mlir::OperationPass<mlir::ModuleOp>(other) {}
  RoundF32ToTF32ForTf32DotRewritePassBase& operator=(const RoundF32ToTF32ForTf32DotRewritePassBase &) = delete;
  RoundF32ToTF32ForTf32DotRewritePassBase(RoundF32ToTF32ForTf32DotRewritePassBase &&) = delete;
  RoundF32ToTF32ForTf32DotRewritePassBase& operator=(RoundF32ToTF32ForTf32DotRewritePassBase &&) = delete;
  ~RoundF32ToTF32ForTf32DotRewritePassBase() = default;

  /// Returns the command-line argument attached to this pass.
  static constexpr ::llvm::StringLiteral getArgumentName() {
    return ::llvm::StringLiteral("round-f32-to-tf32-for-tf32-dot-rewrite");
  }
  ::llvm::StringRef getArgument() const override { return "round-f32-to-tf32-for-tf32-dot-rewrite"; }

  ::llvm::StringRef getDescription() const override { return "dot with tf32 algorithm requires explicit rounding."; }

  /// Returns the derived pass name.
  static constexpr ::llvm::StringLiteral getPassName() {
    return ::llvm::StringLiteral("RoundF32ToTF32ForTf32DotRewritePass");
  }
  ::llvm::StringRef getName() const override { return "RoundF32ToTF32ForTf32DotRewritePass"; }

  /// Support isa/dyn_cast functionality for the derived pass class.
  static bool classof(const ::mlir::Pass *pass) {
    return pass->getTypeID() == ::mlir::TypeID::get<DerivedT>();
  }

  /// A clone method to create a copy of this pass.
  std::unique_ptr<::mlir::Pass> clonePass() const override {
    return std::make_unique<DerivedT>(*static_cast<const DerivedT *>(this));
  }

  /// Register the dialects that must be loaded in the context before this pass.
  void getDependentDialects(::mlir::DialectRegistry &registry) const override {
    
  }

  /// Explicitly declare the TypeID for this class. We declare an explicit private
  /// instantiation because Pass classes should only be visible by the current
  /// library.
  MLIR_DEFINE_EXPLICIT_INTERNAL_INLINE_TYPE_ID(RoundF32ToTF32ForTf32DotRewritePassBase<DerivedT>)

protected:
};

template <typename DerivedT>
class TritonXLAExtractInsertToTritonPassBase : public ::mlir::OperationPass<mlir::ModuleOp> {
public:
  using Base = TritonXLAExtractInsertToTritonPassBase;

  TritonXLAExtractInsertToTritonPassBase() : ::mlir::OperationPass<mlir::ModuleOp>(::mlir::TypeID::get<DerivedT>()) {}
  TritonXLAExtractInsertToTritonPassBase(const TritonXLAExtractInsertToTritonPassBase &other) : ::mlir::OperationPass<mlir::ModuleOp>(other) {}
  TritonXLAExtractInsertToTritonPassBase& operator=(const TritonXLAExtractInsertToTritonPassBase &) = delete;
  TritonXLAExtractInsertToTritonPassBase(TritonXLAExtractInsertToTritonPassBase &&) = delete;
  TritonXLAExtractInsertToTritonPassBase& operator=(TritonXLAExtractInsertToTritonPassBase &&) = delete;
  ~TritonXLAExtractInsertToTritonPassBase() = default;

  /// Returns the command-line argument attached to this pass.
  static constexpr ::llvm::StringLiteral getArgumentName() {
    return ::llvm::StringLiteral("triton-xla-extract-insert-to-triton");
  }
  ::llvm::StringRef getArgument() const override { return "triton-xla-extract-insert-to-triton"; }

  ::llvm::StringRef getDescription() const override { return "Convert Triton XLA extract and insert ops to Triton ops."; }

  /// Returns the derived pass name.
  static constexpr ::llvm::StringLiteral getPassName() {
    return ::llvm::StringLiteral("TritonXLAExtractInsertToTritonPass");
  }
  ::llvm::StringRef getName() const override { return "TritonXLAExtractInsertToTritonPass"; }

  /// Support isa/dyn_cast functionality for the derived pass class.
  static bool classof(const ::mlir::Pass *pass) {
    return pass->getTypeID() == ::mlir::TypeID::get<DerivedT>();
  }

  /// A clone method to create a copy of this pass.
  std::unique_ptr<::mlir::Pass> clonePass() const override {
    return std::make_unique<DerivedT>(*static_cast<const DerivedT *>(this));
  }

  /// Register the dialects that must be loaded in the context before this pass.
  void getDependentDialects(::mlir::DialectRegistry &registry) const override {
    registry.insert<triton::TritonDialect>();
    registry.insert<::xla::XlaDialect>();
  }

  /// Explicitly declare the TypeID for this class. We declare an explicit private
  /// instantiation because Pass classes should only be visible by the current
  /// library.
  MLIR_DEFINE_EXPLICIT_INTERNAL_INLINE_TYPE_ID(TritonXLAExtractInsertToTritonPassBase<DerivedT>)

protected:
};
#undef GEN_PASS_CLASSES
#endif // GEN_PASS_CLASSES
